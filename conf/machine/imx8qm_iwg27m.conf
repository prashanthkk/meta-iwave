## conf/machine/imx8qm_iwg27m.conf
```bitbake
#@TYPE: Machine
#@NAME: iWave iW-RainboW-G37M-i.MX8QM SMARC Development Kit
#@DESCRIPTION: Machine configuration for iWave iW-RainboW-G27M-i.MX8QuadMax SMARC Board
#@MAINTAINER: iWave Systems Technologies Pvt. Ltd.

MACHINEOVERRIDES =. "mx8:mx8qm:"

require conf/machine/include/imx-base.inc
require conf/machine/include/arm/arch-arm64.inc

MACHINE_FEATURES_append = " optee "

PREFERRED_PROVIDER_virtual/bootloader_mx8 = "u-boot-iwg27m"
PREFERRED_PROVIDER_virtual/kernel_mx8 = "linux-iwg27m"

# Don't include kernels in standard images
RDEPENDS_${KERNEL_PACKAGE_NAME}-base = ""

LOADADDR = ""

# We have to disable SERIAL_CONSOLE due to auto-serial-console
SERIAL_CONSOLES = "115200;ttyAMA0"

# we do not want to have getty running on tty1 as we run
# auto-serial-console there
USE_VT = "0"

# Device tree for i.MX8QM IWG27M
KERNEL_DEVICETREE = "freescale/imx8qm-iwg27m.dtb"

UBOOT_MAKE_TARGET = "u-boot.bin"
UBOOT_SUFFIX = "bin"
UBOOT_CONFIG ??= "sd"
UBOOT_CONFIG[sd] = "imx8qm_iwg27m_defconfig,sdcard"

IMAGE_BOOTLOADER = "imx-boot"
IMX_BOOT_SEEK = "32"

WKS_FILE_DEPENDS_append = " firmware-imx-8"
IMAGE_BOOT_FILES += "hdmitxfw.bin hdmirxfw.bin dpfw.bin"

IMAGE_INSTALL_append = " gstreamer1.0-libav obexftp pciutils iw dhcpcd iwtest "
#IMAGE_INSTALL_append = " gstreamer1.0-libav obexftp pciutils iw dhcpcd bluez5 bluez5-noinst-tools bluez5-obex openobex "
LICENSE_FLAGS_WHITELIST = "commercial"

# Possible provider: cacao-initial-native and jamvm-initial-native
#PREFERRED_PROVIDER_virtual/java-initial-native = "cacao-initial-native"

# Possible provider: cacao-native and jamvm-native
#PREFERRED_PROVIDER_virtual/java-native = "cacao-native"

# Optional since there is only one provider for now
#PREFERRED_PROVIDER_virtual/javac-native = "ecj-bootstrap-native"

#IMAGE_INSTALL_append = " openjdk-8"

#CORE_IMAGE_EXTRA_INSTALL += "chromium-ozone-wayland"

SPL_BINARY_imx8qm_iwg27m = \
    "${@bb.utils.contains('MACHINE_FEATURES', 'optee', 'spl/u-boot-spl.bin', \
                                                        '', d)}"

IMXBOOT_TARGETS = \
    "${@bb.utils.contains('UBOOT_CONFIG',         'sd', 'flash_spl', \
                                                        'flash_flexspi', d)}"

BOARD_TYPE = "iwg27m"

# Add additional firmware
MACHINE_FIRMWARE_append = " linux-firmware-ath10k"
```
